## Kconfig.defconfig
```kconfig
# Copyright (c) 2020 The ZMK Contributors
# SPDX-License-Identifier: MIT


if SHIELD_1HID_LEFT

config ZMK_KEYBOARD_NAME
	default "1HID"

config ZMK_SPLIT_ROLE_CENTRAL
	default y

endif

if SHIELD_1HID_LEFT || SHIELD_1HID_RIGHT

config ZMK_SPLIT
	default y
	
endif 
```

## Kconfig.shield
```kconfig
# Copyright (c) 2020 The ZMK Contributors
# SPDX-License-Identifier: MIT

config SHIELD_1HID_LEFT
    def_bool $(shields_list_contains,1hid_left)
#    select SPI
	
config SHIELD_1HID_RIGHT
    def_bool $(shields_list_contains,1hid_right)
#    select SPI
	
```
